/*
 * tecla-cero 左側オーバーレイ設定
 *
 * 左側固有の設定を記述
 * - ロータリーエンコーダ: 有効
 */

#include "tecla_cero.dtsi"
#include <behaviors/battery_history_request.dtsi>

// ロータリーエンコーダを有効化
&left_encoder {
    status = "okay";
};
