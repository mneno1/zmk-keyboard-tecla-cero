/*
 * tecla-cero 右側オーバーレイ設定
 *
 * 右側固有の設定を記述
 * - トラックボール入力処理（input-processors）
 * - 列オフセット: 5（右側のCOL0-4をCOL5-9にマッピング）
 */

#include "tecla_cero.dtsi"
#include <input/processors.dtsi>
#include <dt-bindings/zmk/input_transform.h>

// トラックボールの座標変換 + レイヤー別スクロール設定
&pointing_listener {
    input-processors = <&zip_xy_transform (INPUT_TRANSFORM_X_INVERT | INPUT_TRANSFORM_Y_INVERT)>,
                       <&zip_temp_layer 6 1000>;

    slow-cursor-layer {
        layers = <4>;
        input-processors = <&zip_xy_scaler 1 2>,
                           <&zip_xy_transform (INPUT_TRANSFORM_X_INVERT | INPUT_TRANSFORM_Y_INVERT)>;
    };
};

// 右側のキーマトリクス列オフセット
// 右側のCOL0-4を論理的にCOL5-9として扱う
&default_transform {
    col-offset = <5>;
};

&zip_temp_layer {
    require-prior-idle-ms = <200>;
    excluded-positions = <
        15 // H
        16 // J
        17 // K
        18 // L
    >;
};
